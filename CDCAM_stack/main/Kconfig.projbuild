## CDCAM_stack/main/Kconfig.projbuild
```kconfig
menu "CDC UART Bridge"

    config UART_RX_PIN
        int "RX Pin for bridge UART"
        default 17

    config UART_TX_PIN
        int "TX Pin for bridge UART"
        default 18

    config DTR_PIN
        int "DTR pin to control resets"
        default 5

    config RTS_PIN
        int "RTS pin to control resets"
        default 6

    config UART_RX_BUFSIZE
        int "UART bridge RX buffer size"
        default 2048

    config UART_TX_BUFSIZE
        int "UART bridge TX buffer size"
        default 2048

    
endmenu
```

## ESPL2303_stack/main/Kconfig.projbuild
```kconfig
menu "ESPL2303 Bridge"

    config EP_VENDOR_BULK_OUT
        hex "Bulk OUT vendor endpoint address"
        default 0x02

    config EP_VENDOR_BULK_IN
        hex "Bulk IN vendor endpoint address"
        default 0x83

    config EP_VENDOR_IRQ
        hex "Interrupt vendor endpoint address"
        default 0x81
        
    config BRIDGE_UART_RX_BUFFER_SIZE
        int "Buffer size for UART RX on Bridge"
        default 2048

    config BRIDGE_UART_TX_BUFFER_SIZE
        int "Buffer size for UART TX on Bridge"
        default 2048 
    
    config BRIDGE_RX_PIN
        int "RX IO for the UART bridge"
        default 17

    config BRIDGE_TX_PIN
        int "TX IO for the UART bridge"
        default 18 

    config DTR_PIN
        int "DTR pin to control resets"
        default 15

    config RTS_PIN
        int "RTS pin to control resets"
        default 16
    
endmenu
```
